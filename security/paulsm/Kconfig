## security/paulsm/Kconfig
```kconfig
# SPDX-License-Identifier: GPL-2.0-only
config SECURITY_PAULSM
	bool "Prevents any file that starts with `paul` to be deleted"
	depends on SECURITY && BLOCK
	help
	  Any hard link unlinking on files that starts with `paul` will be prevented, and an error message will be displayed.

config SECURITY_PAULSM_ENFORCE
	bool "Enforce paulsm at boot"
	depends on SECURITY_PAULSM
	help
	  If selected, paulsm will be enforced at boot.
```
